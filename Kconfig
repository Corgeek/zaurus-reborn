## Kconfig
```kconfig
# Copyright (c) 2026 Takayuki Goto <tkg.develop@gmail.com>
# SPDX-License-Identifier: Apache-2.0

mainmenu "Zaurus SL-C3x00 application configuration"

menu "Zaurus"

rsource "drivers/Kconfig"
rsource "services/Kconfig"

endmenu

source "Kconfig.zephyr"
```

## drivers/Kconfig
```kconfig
# Copyright (c) 2026 Takayuki Goto <tkg.develop@gmail.com>
# SPDX-License-Identifier: Apache-2.0

rsource "term/Kconfig"
rsource "usbh/Kconfig"
```

## drivers/kbd/Kconfig
```kconfig
# Copyright (c) 2026 Takayuki Goto <tkg.develop@gmail.com>
# SPDX-License-Identifier: Apache-2.0

config DRV_KBD
    bool "Text from Zaurus C3x00 key events"
    depends on INPUT
    help
      Turns INPUT_EV_KEY events into characters and VT100 sequences,
      following the keycaps of the Sharp Zaurus C3x00 keyboard, where
      the symbols sit on Shift and Fn rather than on keys of their own.

if DRV_KBD

config DRV_KBD_FN_KEY
    int "Key code of the Fn modifier"
    default 61
    help
      Input key code that acts as Fn. 61 is INPUT_KEY_F3, which Linux's
      spitz keymap and the board's keymap give the Fn key.

endif # DRV_KBD
```

## drivers/shell/Kconfig
```kconfig
# Copyright (c) 2026 Takayuki Goto <tkg.develop@gmail.com>
# SPDX-License-Identifier: Apache-2.0

config DRV_SHELL
    bool "Shell on the terminal and a keyboard"
    depends on SHELL && INPUT && DRV_TERM
    select DRV_KBD
    help
      Shell backend that prints on the terminal (and the UART
      console, when there is one) and reads key events from the input
      subsystem, with the Zaurus C3x00 keycap layout for symbols.

if DRV_SHELL

config DRV_SHELL_PROMPT
    string "Prompt"
    default "zaurus:~$ "

config DRV_SHELL_RX_BUF_SIZE
    int "Input buffer size"
    default 64

endif # DRV_SHELL
```

## drivers/term/Kconfig
```kconfig
# Copyright (c) 2026 Takayuki Goto <tkg.develop@gmail.com>
# SPDX-License-Identifier: Apache-2.0

DT_CHOSEN_Z_DISPLAY := zephyr,display

menuconfig DRV_TERM
    bool "Terminal on the display"
    depends on DISPLAY
    depends on $(dt_chosen_enabled,$(DT_CHOSEN_Z_DISPLAY))
    select CHARACTER_FRAMEBUFFER
    select UART_CONSOLE_DEBUG_SERVER_HOOKS if UART_CONSOLE
    help
      Show printk(), stdout and log output on the zephyr,display, which
      has to expose an RGB565 framebuffer. With the UART console enabled
      the output goes to both.

if DRV_TERM

config DRV_TERM_ROTATION
    int "Text rotation against the panel, in degrees clockwise"
    range 0 270
    default 0
    help
      0, 90, 180 or 270. With 90, the top of the text faces the panel's
      right edge: for a portrait panel mounted on its side.

config DRV_TERM_FONT_HEIGHT
    int "Font height in pixels"
    default 16
    help
      Height of the character framebuffer font to use. The smallest
      available font is used when none has this height.

config DRV_TERM_LOG_BACKEND
    bool "Log backend"
    default y
    depends on LOG && !LOG_MODE_MINIMAL
    help
      Show log messages on the display as well. In minimal log mode they
      go through printk() and appear without this.

config DRV_TERM_INIT_PRIORITY
    int "Init priority"
    default 90
    help
      POST_KERNEL priority, after the display and its panel drivers.

endif # DRV_TERM
```

## drivers/usbh/Kconfig
```kconfig
# Copyright (c) 2026 Takayuki Goto <tkg.develop@gmail.com>
# SPDX-License-Identifier: Apache-2.0

config DRV_USBH
    bool "Enable the USB host at boot"
    depends on USB_HOST_STACK
    depends on $(dt_nodelabel_enabled,zephyr_uhc0)
    help
      Initializes and enables the USB host stack on the zephyr_uhc0
      controller at boot.

if DRV_USBH

config DRV_USBH_INIT_PRIORITY
    int "Init priority"
    default 0
    help
      APPLICATION priority.

endif # DRV_USBH
```

## services/beacon/Kconfig
```kconfig
# Copyright (c) 2026 Takayuki Goto <tkg.develop@gmail.com>
# SPDX-License-Identifier: Apache-2.0

config SVC_BEACON
    bool "Distance to Bluetooth LE advertisers"
    depends on BT_OBSERVER
    help
      Scans for Bluetooth LE advertisers and estimates the distance to
      each from its smoothed RSSI, with the log-distance path loss model.

if SVC_BEACON

config SVC_BEACON_MAX_DEVICES
    int "Advertisers tracked at a time"
    default 32
    help
      When the table is full, the advertiser heard from longest ago
      makes room for a new one.

config SVC_BEACON_TIMEOUT_MS
    int "Time after which a silent advertiser is dropped, in milliseconds"
    default 10000

config SVC_BEACON_RSSI_SMOOTHING
    int "RSSI smoothing divisor"
    range 1 64
    default 4
    help
      Each advertisement moves the smoothed RSSI by the difference
      divided by this value: 1 shows the raw RSSI, larger values react
      more slowly and fluctuate less.

config SVC_BEACON_DEFAULT_TXPOWER
    int "Expected RSSI at 1 m, in dBm, for uncalibrated advertisers"
    range -100 0
    default -59
    help
      Used when the advertisement carries neither an iBeacon or
      Eddystone calibration nor a TX Power Level. -59 dBm is the usual
      iBeacon figure for a phone-sized transmitter.

config SVC_BEACON_PATH_LOSS_X10
    int "Path loss exponent, in tenths"
    range 10 60
    default 20
    help
      n in the log-distance path loss model, times 10: 20 for free
      space, 25 to 40 indoors with walls and people in the way.

config SVC_BEACON_IMMEDIATE_CM
    int "Upper limit of the immediate range, in centimeters"
    default 50

config SVC_BEACON_NEAR_CM
    int "Upper limit of the near range, in centimeters"
    default 300

endif # SVC_BEACON
```

## services/power/Kconfig
```kconfig
# Copyright (c) 2026 Takayuki Goto <tkg.develop@gmail.com>
# SPDX-License-Identifier: Apache-2.0

config SVC_POWER
    bool "Power service"
    depends on HAS_POWEROFF && INPUT
    select POWEROFF
    help
      Powers the machine off when the power key is held, or on the
      poweroff shell command. The boot loader starts it again on the
      power key.

if SVC_POWER

config SVC_POWER_KEY_HOLD_MS
    int "Power key hold time to power off, in milliseconds"
    default 1000

endif # SVC_POWER
```

## west.yml
```yaml
manifest:
  defaults:
    remote: corgeek

  remotes:
    - name: corgeek
      url-base: https://github.com/Corgeek

  projects:
    - name: zephyr
      repo-path: zephyr-rtos
      path: zephyr
      remote: corgeek
      revision: zaurus
      clone-depth: 1
      west-commands: scripts/west-commands.yml
      import:
        name-allowlist:
          - fatfs
          - lvgl
          - mbedtls
          - tf-psa-crypto
```
